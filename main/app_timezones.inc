/* Generated by tools/generate_timezones.py; IANA 2026f, public-domain data. */
#define APP_TIMEZONE_START INT64_C(1577836800)
#define APP_TIMEZONE_END INT64_C(4133980800)
static const timezone_transition_t TIMEZONE_TRANSITIONS[] = {
    {104796000U, 10800},
    {120517200U, 7200},
    {136245600U, 10800},
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    {2548335600U, 43200},
};
static const timezone_group_t TIMEZONE_GROUPS[] = {
    {0, 0, 0},
    {0, 0, 10800},
    {0, 0, 3600},
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    {5196, 162, 43200},
};
static const timezone_name_t TIMEZONE_NAMES[] = {
    {"Africa/Abidjan", 0},
    {"Africa/Accra", 0},
    {"Africa/Addis_Ababa", 1},
    {"Africa/Algiers", 2},
    {"Africa/Asmara", 1},
    {"Africa/Asmera", 1},
    {"Africa/Bamako", 0},
    {"Africa/Bangui", 2},
    {"Africa/Banjul", 0},
    {"Africa/Bissau", 0},
    {"Africa/Blantyre", 3},
    {"Africa/Brazzaville", 2},
    {"Africa/Bujumbura", 3},
    {"Africa/Cairo", 4},
    {"Africa/Casablanca", 5},
    {"Africa/Ceuta", 6},
    {"Africa/Conakry", 0},
    {"Africa/Dakar", 0},
    {"Africa/Dar_es_Salaam", 1},
    {"Africa/Djibouti", 1},
    {"Africa/Douala", 2},
    {"Africa/El_Aaiun", 5},
    {"Africa/Freetown", 0},
    {"Africa/Gaborone", 3},
    {"Africa/Harare", 3},
    {"Africa/Johannesburg", 3},
    {"Africa/Juba", 7},
    {"Africa/Kampala", 1},
    {"Africa/Khartoum", 3},
    {"Africa/Kigali", 3},
    {"Africa/Kinshasa", 2},
    {"Africa/Lagos", 2},
    {"Africa/Libreville", 2},
    {"Africa/Lome", 0},
    {"Africa/Luanda", 2},
    {"Africa/Lubumbashi", 3},
    {"Africa/Lusaka", 3},
    {"Africa/Malabo", 2},
    {"Africa/Maputo", 3},
    {"Africa/Maseru", 3},
    {"Africa/Mbabane", 3},
    {"Africa/Mogadishu", 1},
    {"Africa/Monrovia", 0},
    {"Africa/Nairobi", 1},
    {"Africa/Ndjamena", 2},
    {"Africa/Niamey", 2},
    {"Africa/Nouakchott", 0},
    {"Africa/Ouagadougou", 0},
    {"Africa/Porto-Novo", 2},
    {"Africa/Sao_Tome", 0},
    {"Africa/Timbuktu", 0},
    {"Africa/Tripoli", 3},
    {"Africa/Tunis", 2},
    {"Africa/Windhoek", 3},
    {"America/Adak", 8},
    {"America/Anchorage", 9},
    {"America/Anguilla", 10},
    {"America/Antigua", 10},
    {"America/Araguaina", 11},
    {"America/Argentina/Buenos_Aires", 11},
    {"America/Argentina/Catamarca", 11},
    {"America/Argentina/ComodRivadavia", 11},
    {"America/Argentina/Cordoba", 11},
    {"America/Argentina/Jujuy", 11},
    {"America/Argentina/La_Rioja", 11},
    {"America/Argentina/Mendoza", 11},
    {"America/Argentina/Rio_Gallegos", 11},
    {"America/Argentina/Salta", 11},
    {"America/Argentina/San_Juan", 11},
    {"America/Argentina/San_Luis", 11},
    {"America/Argentina/Tucuman", 11},
    {"America/Argentina/Ushuaia", 11},
    {"America/Aruba", 10},
    {"America/Asuncion", 12},
    {"America/Atikokan", 13},
    {"America/Atka", 8},
    {"America/Bahia", 11},
    {"America/Bahia_Banderas", 14},
    {"America/Barbados", 10},
    {"America/Belem", 11},
    {"America/Belize", 15},
    {"America/Blanc-Sablon", 10},
    {"America/Boa_Vista", 10},
    {"America/Bogota", 13},
    {"America/Boise", 16},
    {"America/Buenos_Aires", 11},
    {"America/Cambridge_Bay", 16},
    {"America/Campo_Grande", 10},
    {"America/Cancun", 13},
    {"America/Caracas", 10},
    {"America/Catamarca", 11},
    {"America/Cayenne", 11},
    {"America/Cayman", 13},
    {"America/Chicago", 17},
    {"America/Chihuahua", 18},
    {"America/Ciudad_Juarez", 19},
    {"America/Coral_Harbour", 13},
    {"America/Cordoba", 11},
    {"America/Costa_Rica", 15},
    {"America/Coyhaique", 20},
    {"America/Creston", 21},
    {"America/Cuiaba", 10},
    {"America/Curacao", 10},
    {"America/Danmarkshavn", 0},
    {"America/Dawson", 22},
    {"America/Dawson_Creek", 21},
    {"America/Denver", 16},
    {"America/Detroit", 23},
    {"America/Dominica", 10},
    {"America/Edmonton", 24},
    {"America/Eirunepe", 13},
    {"America/El_Salvador", 15},
    {"America/Ensenada", 25},
    {"America/Fort_Nelson", 21},
    {"America/Fort_Wayne", 23},
    {"America/Fortaleza", 11},
    {"America/Glace_Bay", 26},
    {"America/Godthab", 27},
    {"America/Goose_Bay", 26},
    {"America/Grand_Turk", 23},
    {"America/Grenada", 10},
    {"America/Guadeloupe", 10},
    {"America/Guatemala", 15},
    {"America/Guayaquil", 13},
    {"America/Guyana", 10},
    {"America/Halifax", 26},
    {"America/Havana", 28},
    {"America/Hermosillo", 21},
    {"America/Indiana/Indianapolis", 23},
    {"America/Indiana/Knox", 17},
    {"America/Indiana/Marengo", 23},
    {"America/Indiana/Petersburg", 23},
    {"America/Indiana/Tell_City", 17},
    {"America/Indiana/Vevay", 23},
    {"America/Indiana/Vincennes", 23},
    {"America/Indiana/Winamac", 23},
    {"America/Indianapolis", 23},
    {"America/Inuvik", 24},
    {"America/Iqaluit", 23},
    {"America/Jamaica", 13},
    {"America/Jujuy", 11},
    {"America/Juneau", 9},
    {"America/Kentucky/Louisville", 23},
    {"America/Kentucky/Monticello", 23},
    {"America/Knox_IN", 17},
    {"America/Kralendijk", 10},
    {"America/La_Paz", 10},
    {"America/Lima", 13},
    {"America/Los_Angeles", 25},
    {"America/Louisville", 23},
    {"America/Lower_Princes", 10},
    {"America/Maceio", 11},
    {"America/Managua", 15},
    {"America/Manaus", 10},
    {"America/Marigot", 10},
    {"America/Martinique", 10},
    {"America/Matamoros", 17},
    {"America/Mazatlan", 29},
    {"America/Mendoza", 11},
    {"America/Menominee", 17},
    {"America/Merida", 14},
    {"America/Metlakatla", 9},
    {"America/Mexico_City", 14},
    {"America/Miquelon", 30},
    {"America/Moncton", 26},
    {"America/Monterrey", 14},
    {"America/Montevideo", 11},
    {"America/Montreal", 23},
    {"America/Montserrat", 10},
    {"America/Nassau", 23},
    {"America/New_York", 23},
    {"America/Nipigon", 23},
    {"America/Nome", 9},
    {"America/Noronha", 31},
    {"America/North_Dakota/Beulah", 17},
    {"America/North_Dakota/Center", 17},
    {"America/North_Dakota/New_Salem", 17},
    {"America/Nuuk", 27},
    {"America/Ojinaga", 32},
    {"America/Panama", 13},
    {"America/Pangnirtung", 23},
    {"America/Paramaribo", 11},
    {"America/Phoenix", 21},
    {"America/Port-au-Prince", 23},
    {"America/Port_of_Spain", 10},
    {"America/Porto_Acre", 13},
    {"America/Porto_Velho", 10},
    {"America/Puerto_Rico", 10},
    {"America/Punta_Arenas", 11},
    {"America/Rainy_River", 33},
    {"America/Rankin_Inlet", 17},
    {"America/Recife", 11},
    {"America/Regina", 15},
    {"America/Resolute", 17},
    {"America/Rio_Branco", 13},
    {"America/Rosario", 11},
    {"America/Santa_Isabel", 25},
    {"America/Santarem", 11},
    {"America/Santiago", 34},
    {"America/Santo_Domingo", 10},
    {"America/Sao_Paulo", 11},
    {"America/Scoresbysund", 35},
    {"America/Shiprock", 16},
    {"America/Sitka", 9},
    {"America/St_Barthelemy", 10},
    {"America/St_Johns", 36},
    {"America/St_Kitts", 10},
    {"America/St_Lucia", 10},
    {"America/St_Thomas", 10},
    {"America/St_Vincent", 10},
    {"America/Swift_Current", 15},
    {"America/Tegucigalpa", 15},
    {"America/Thule", 26},
    {"America/Thunder_Bay", 23},
    {"America/Tijuana", 25},
    {"America/Toronto", 23},
    {"America/Tortola", 10},
    {"America/Vancouver", 37},
    {"America/Virgin", 10},
    {"America/Whitehorse", 22},
    {"America/Winnipeg", 33},
    {"America/Yakutat", 9},
    {"America/Yellowknife", 24},
    {"Antarctica/Casey", 38},
    {"Antarctica/Davis", 39},
    {"Antarctica/DumontDUrville", 40},
    {"Antarctica/Macquarie", 41},
    {"Antarctica/Mawson", 42},
    {"Antarctica/McMurdo", 43},
    {"Antarctica/Palmer", 11},
    {"Antarctica/Rothera", 11},
    {"Antarctica/South_Pole", 43},
    {"Antarctica/Syowa", 1},
    {"Antarctica/Troll", 44},
    {"Antarctica/Vostok", 45},
    {"Arctic/Longyearbyen", 6},
    {"Asia/Aden", 1},
    {"Asia/Almaty", 46},
    {"Asia/Amman", 47},
    {"Asia/Anadyr", 48},
    {"Asia/Aqtau", 42},
    {"Asia/Aqtobe", 42},
    {"Asia/Ashgabat", 42},
    {"Asia/Ashkhabad", 42},
    {"Asia/Atyrau", 42},
    {"Asia/Baghdad", 1},
    {"Asia/Bahrain", 1},
    {"Asia/Baku", 49},
    {"Asia/Bangkok", 39},
    {"Asia/Barnaul", 39},
    {"Asia/Beirut", 50},
    {"Asia/Bishkek", 51},
    {"Asia/Brunei", 52},
    {"Asia/Calcutta", 53},
    {"Asia/Chita", 54},
    {"Asia/Choibalsan", 52},
    {"Asia/Chongqing", 52},
    {"Asia/Chungking", 52},
    {"Asia/Colombo", 53},
    {"Asia/Dacca", 51},
    {"Asia/Damascus", 55},
    {"Asia/Dhaka", 51},
    {"Asia/Dili", 54},
    {"Asia/Dubai", 49},
    {"Asia/Dushanbe", 42},
    {"Asia/Famagusta", 56},
    {"Asia/Gaza", 57},
    {"Asia/Harbin", 52},
    {"Asia/Hebron", 57},
    {"Asia/Ho_Chi_Minh", 39},
    {"Asia/Hong_Kong", 52},
    {"Asia/Hovd", 39},
    {"Asia/Irkutsk", 52},
    {"Asia/Istanbul", 1},
    {"Asia/Jakarta", 39},
    {"Asia/Jayapura", 54},
    {"Asia/Jerusalem", 58},
    {"Asia/Kabul", 59},
    {"Asia/Kamchatka", 48},
    {"Asia/Karachi", 42},
    {"Asia/Kashgar", 51},
    {"Asia/Kathmandu", 60},
    {"Asia/Katmandu", 60},
    {"Asia/Khandyga", 54},
    {"Asia/Kolkata", 53},
    {"Asia/Krasnoyarsk", 39},
    {"Asia/Kuala_Lumpur", 52},
    {"Asia/Kuching", 52},
    {"Asia/Kuwait", 1},
    {"Asia/Macao", 52},
    {"Asia/Macau", 52},
    {"Asia/Magadan", 61},
    {"Asia/Makassar", 52},
    {"Asia/Manila", 52},
    {"Asia/Muscat", 49},
    {"Asia/Nicosia", 56},
    {"Asia/Novokuznetsk", 39},
    {"Asia/Novosibirsk", 39},
    {"Asia/Omsk", 51},
    {"Asia/Oral", 42},
    {"Asia/Phnom_Penh", 39},
    {"Asia/Pontianak", 39},
    {"Asia/Pyongyang", 54},
    {"Asia/Qatar", 1},
    {"Asia/Qostanay", 46},
    {"Asia/Qyzylorda", 42},
    {"Asia/Rangoon", 62},
    {"Asia/Riyadh", 1},
    {"Asia/Saigon", 39},
    {"Asia/Sakhalin", 61},
    {"Asia/Samarkand", 42},
    {"Asia/Seoul", 54},
    {"Asia/Shanghai", 52},
    {"Asia/Singapore", 52},
    {"Asia/Srednekolymsk", 61},
    {"Asia/Taipei", 52},
    {"Asia/Tashkent", 42},
    {"Asia/Tbilisi", 49},
    {"Asia/Tehran", 63},
    {"Asia/Tel_Aviv", 58},
    {"Asia/Thimbu", 51},
    {"Asia/Thimphu", 51},
    {"Asia/Tokyo", 54},
    {"Asia/Tomsk", 39},
    {"Asia/Ujung_Pandang", 52},
    {"Asia/Ulaanbaatar", 52},
    {"Asia/Ulan_Bator", 52},
    {"Asia/Urumqi", 51},
    {"Asia/Ust-Nera", 40},
    {"Asia/Vientiane", 39},
    {"Asia/Vladivostok", 40},
    {"Asia/Yakutsk", 54},
    {"Asia/Yangon", 62},
    {"Asia/Yekaterinburg", 42},
    {"Asia/Yerevan", 49},
    {"Atlantic/Azores", 64},
    {"Atlantic/Bermuda", 26},
    {"Atlantic/Canary", 65},
    {"Atlantic/Cape_Verde", 66},
    {"Atlantic/Faeroe", 65},
    {"Atlantic/Faroe", 65},
    {"Atlantic/Jan_Mayen", 6},
    {"Atlantic/Madeira", 65},
    {"Atlantic/Reykjavik", 0},
    {"Atlantic/South_Georgia", 31},
    {"Atlantic/St_Helena", 0},
    {"Atlantic/Stanley", 11},
    {"Australia/ACT", 41},
    {"Australia/Adelaide", 67},
    {"Australia/Brisbane", 40},
    {"Australia/Broken_Hill", 67},
    {"Australia/Canberra", 41},
    {"Australia/Currie", 41},
    {"Australia/Darwin", 68},
    {"Australia/Eucla", 69},
    {"Australia/Hobart", 41},
    {"Australia/LHI", 70},
    {"Australia/Lindeman", 40},
    {"Australia/Lord_Howe", 70},
    {"Australia/Melbourne", 41},
    {"Australia/NSW", 41},
    {"Australia/North", 68},
    {"Australia/Perth", 52},
    {"Australia/Queensland", 40},
    {"Australia/South", 67},
    {"Australia/Sydney", 41},
    {"Australia/Tasmania", 41},
    {"Australia/Victoria", 41},
    {"Australia/West", 52},
    {"Australia/Yancowinna", 67},
    {"Brazil/Acre", 13},
    {"Brazil/DeNoronha", 31},
    {"Brazil/East", 11},
    {"Brazil/West", 10},
    {"CET", 6},
    {"CST6CDT", 17},
    {"Canada/Atlantic", 26},
    {"Canada/Central", 33},
    {"Canada/Eastern", 23},
    {"Canada/Mountain", 24},
    {"Canada/Newfoundland", 36},
    {"Canada/Pacific", 37},
    {"Canada/Saskatchewan", 15},
    {"Canada/Yukon", 22},
    {"Chile/Continental", 34},
    {"Chile/EasterIsland", 71},
    {"Cuba", 28},
    {"EET", 56},
    {"EST", 13},
    {"EST5EDT", 23},
    {"Egypt", 4},
    {"Eire", 65},
    {"Etc/GMT", 0},
    {"Etc/GMT+0", 0},
    {"Etc/GMT+1", 66},
    {"Etc/GMT+10", 72},
    {"Etc/GMT+11", 73},
    {"Etc/GMT+12", 74},
    {"Etc/GMT+2", 31},
    {"Etc/GMT+3", 11},
    {"Etc/GMT+4", 10},
    {"Etc/GMT+5", 13},
    {"Etc/GMT+6", 15},
    {"Etc/GMT+7", 21},
    {"Etc/GMT+8", 75},
    {"Etc/GMT+9", 76},
    {"Etc/GMT-0", 0},
    {"Etc/GMT-1", 2},
    {"Etc/GMT-10", 40},
    {"Etc/GMT-11", 61},
    {"Etc/GMT-12", 48},
    {"Etc/GMT-13", 77},
    {"Etc/GMT-14", 78},
    {"Etc/GMT-2", 3},
    {"Etc/GMT-3", 1},
    {"Etc/GMT-4", 49},
    {"Etc/GMT-5", 42},
    {"Etc/GMT-6", 51},
    {"Etc/GMT-7", 39},
    {"Etc/GMT-8", 52},
    {"Etc/GMT-9", 54},
    {"Etc/GMT0", 0},
    {"Etc/Greenwich", 0},
    {"Etc/UCT", 0},
    {"Etc/UTC", 0},
    {"Etc/Universal", 0},
    {"Etc/Zulu", 0},
    {"Europe/Amsterdam", 6},
    {"Europe/Andorra", 6},
    {"Europe/Astrakhan", 49},
    {"Europe/Athens", 56},
    {"Europe/Belfast", 65},
    {"Europe/Belgrade", 6},
    {"Europe/Berlin", 6},
    {"Europe/Bratislava", 6},
    {"Europe/Brussels", 6},
    {"Europe/Bucharest", 56},
    {"Europe/Budapest", 6},
    {"Europe/Busingen", 6},
    {"Europe/Chisinau", 79},
    {"Europe/Copenhagen", 6},
    {"Europe/Dublin", 65},
    {"Europe/Gibraltar", 6},
    {"Europe/Guernsey", 65},
    {"Europe/Helsinki", 56},
    {"Europe/Isle_of_Man", 65},
    {"Europe/Istanbul", 1},
    {"Europe/Jersey", 65},
    {"Europe/Kaliningrad", 3},
    {"Europe/Kiev", 56},
    {"Europe/Kirov", 1},
    {"Europe/Kyiv", 56},
    {"Europe/Lisbon", 65},
    {"Europe/Ljubljana", 6},
    {"Europe/London", 65},
    {"Europe/Luxembourg", 6},
    {"Europe/Madrid", 6},
    {"Europe/Malta", 6},
    {"Europe/Mariehamn", 56},
    {"Europe/Minsk", 1},
    {"Europe/Monaco", 6},
    {"Europe/Moscow", 1},
    {"Europe/Nicosia", 56},
    {"Europe/Oslo", 6},
    {"Europe/Paris", 6},
    {"Europe/Podgorica", 6},
    {"Europe/Prague", 6},
    {"Europe/Riga", 56},
    {"Europe/Rome", 6},
    {"Europe/Samara", 49},
    {"Europe/San_Marino", 6},
    {"Europe/Sarajevo", 6},
    {"Europe/Saratov", 49},
    {"Europe/Simferopol", 1},
    {"Europe/Skopje", 6},
    {"Europe/Sofia", 56},
    {"Europe/Stockholm", 6},
    {"Europe/Tallinn", 56},
    {"Europe/Tirane", 6},
    {"Europe/Tiraspol", 79},
    {"Europe/Ulyanovsk", 49},
    {"Europe/Uzhgorod", 56},
    {"Europe/Vaduz", 6},
    {"Europe/Vatican", 6},
    {"Europe/Vienna", 6},
    {"Europe/Vilnius", 56},
    {"Europe/Volgograd", 80},
    {"Europe/Warsaw", 6},
    {"Europe/Zagreb", 6},
    {"Europe/Zaporozhye", 56},
    {"Europe/Zurich", 6},
    {"Factory", 0},
    {"GB", 65},
    {"GB-Eire", 65},
    {"GMT", 0},
    {"GMT+0", 0},
    {"GMT-0", 0},
    {"GMT0", 0},
    {"Greenwich", 0},
    {"HST", 72},
    {"Hongkong", 52},
    {"Iceland", 0},
    {"Indian/Antananarivo", 1},
    {"Indian/Chagos", 51},
    {"Indian/Christmas", 39},
    {"Indian/Cocos", 62},
    {"Indian/Comoro", 1},
    {"Indian/Kerguelen", 42},
    {"Indian/Mahe", 49},
    {"Indian/Maldives", 42},
    {"Indian/Mauritius", 49},
    {"Indian/Mayotte", 1},
    {"Indian/Reunion", 49},
    {"Iran", 63},
    {"Israel", 58},
    {"Jamaica", 13},
    {"Japan", 54},
    {"Kwajalein", 48},
    {"Libya", 3},
    {"MET", 6},
    {"MST", 21},
    {"MST7MDT", 16},
    {"Mexico/BajaNorte", 25},
    {"Mexico/BajaSur", 29},
    {"Mexico/General", 14},
    {"NZ", 43},
    {"NZ-CHAT", 81},
    {"Navajo", 16},
    {"PRC", 52},
    {"PST8PDT", 25},
    {"Pacific/Apia", 82},
    {"Pacific/Auckland", 43},
    {"Pacific/Bougainville", 61},
    {"Pacific/Chatham", 81},
    {"Pacific/Chuuk", 40},
    {"Pacific/Easter", 71},
    {"Pacific/Efate", 61},
    {"Pacific/Enderbury", 77},
    {"Pacific/Fakaofo", 77},
    {"Pacific/Fiji", 83},
    {"Pacific/Funafuti", 48},
    {"Pacific/Galapagos", 15},
    {"Pacific/Gambier", 76},
    {"Pacific/Guadalcanal", 61},
    {"Pacific/Guam", 40},
    {"Pacific/Honolulu", 72},
    {"Pacific/Johnston", 72},
    {"Pacific/Kanton", 77},
    {"Pacific/Kiritimati", 78},
    {"Pacific/Kosrae", 61},
    {"Pacific/Kwajalein", 48},
    {"Pacific/Majuro", 48},
    {"Pacific/Marquesas", 84},
    {"Pacific/Midway", 73},
    {"Pacific/Nauru", 48},
    {"Pacific/Niue", 73},
    {"Pacific/Norfolk", 85},
    {"Pacific/Noumea", 61},
    {"Pacific/Pago_Pago", 73},
    {"Pacific/Palau", 54},
    {"Pacific/Pitcairn", 75},
    {"Pacific/Pohnpei", 61},
    {"Pacific/Ponape", 61},
    {"Pacific/Port_Moresby", 40},
    {"Pacific/Rarotonga", 72},
    {"Pacific/Saipan", 40},
    {"Pacific/Samoa", 73},
    {"Pacific/Tahiti", 72},
    {"Pacific/Tarawa", 48},
    {"Pacific/Tongatapu", 77},
    {"Pacific/Truk", 40},
    {"Pacific/Wake", 48},
    {"Pacific/Wallis", 48},
    {"Pacific/Yap", 40},
    {"Poland", 6},
    {"Portugal", 65},
    {"ROC", 52},
    {"ROK", 54},
    {"Singapore", 52},
    {"Turkey", 1},
    {"UCT", 0},
    {"US/Alaska", 9},
    {"US/Aleutian", 8},
    {"US/Arizona", 21},
    {"US/Central", 17},
    {"US/East-Indiana", 23},
    {"US/Eastern", 23},
    {"US/Hawaii", 72},
    {"US/Indiana-Starke", 17},
    {"US/Michigan", 23},
    {"US/Mountain", 16},
    {"US/Pacific", 25},
    {"US/Samoa", 73},
    {"UTC", 0},
    {"Universal", 0},
    {"W-SU", 1},
    {"WET", 65},
    {"Zulu", 0},
};
